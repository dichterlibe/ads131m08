/dts-v1/;
/plugin/;

/ {
    compatible = "brcm,bcm2712";

    fragment@0 {
        target = <&spi5>;
        __overlay__ {
            #address-cells = <1>;
            #size-cells = <0>;
            status = "okay";
            cs-gpios = <0>, <&gpio 12 0>;

            ads131m08: ads131m08@0 {
                compatible = "ti,ads131m08";
                reg = <0>;
                spi-max-frequency = <15000000>;
                drdy-gpios = <&gpio 18 0>;
                reset-gpios = <&gpio 16 0>;
                status = "okay";
            };
        };
    };
};
